## package/kata-runtime/Config.in
```kconfig
config BR2_PACKAGE_KATA_RUNTIME
	bool "kata-runtime"
	depends on BR2_PACKAGE_HOST_GO_ARCH_SUPPORTS
	depends on BR2_PACKAGE_HOST_GO_CGO_LINKING_SUPPORTS
	depends on BR2_TOOLCHAIN_HAS_THREADS
	depends on BR2_USE_MMU
	help
	  Kata Containers provides a standards-compliant
	  hardware-virtualized Linux container runtime.

	  https://github.com/kata-containers/runtime

comment "kata-runtime needs a toolchain w/ threads"
	depends on BR2_PACKAGE_HOST_GO_ARCH_SUPPORTS
	depends on BR2_PACKAGE_HOST_GO_CGO_LINKING_SUPPORTS
	depends on !BR2_TOOLCHAIN_HAS_THREADS

comment "kata-runtime needs a toolchain w/ threads"
	depends on BR2_PACKAGE_HOST_GO_ARCH_SUPPORTS
	depends on BR2_PACKAGE_HOST_GO_CGO_LINKING_SUPPORTS
	depends on !BR2_TOOLCHAIN_HAS_THREADS
	depends on BR2_USE_MMU
```

## package/rtl8188fu/Config.in
```kconfig
comment "rtl8188fu needs a Linux kernel to be built"
	depends on !BR2_LINUX_KERNEL

config BR2_PACKAGE_RTL8188FU
	bool "rtl8188fu"
	depends on BR2_LINUX_KERNEL
	help
	  rtl8188fu wifi driver

	  https://github.com/ulli-kroll/rtl8188fu
```
